/*=====================================================================================================*/
/*=====================================================================================================*/
#include "stm32f1_system.h"
#include "stm32f1_delay.h"
/*=====================================================================================================*/
/*=====================================================================================================*
**函數 : Delay_nop
**功能 : 延遲一個while時間
**輸入 : nCnt
**輸出 : None
**使用 : Delay_nop(Times);
**=====================================================================================================*/
/*=====================================================================================================*/
void Delay_nop( vu32 nCnt )
{
  while(nCnt--) {
  }
}
/*=====================================================================================================*/
/*=====================================================================================================*
**函數 : Delay_1us
**功能 : 延遲 1us
**輸入 : nCnt_1us
**輸出 : None
**使用 : Delay_1us(Times);
**=====================================================================================================*/
/*=====================================================================================================*/
void Delay_1us( vu32 nCnt_1us )
{
  u32 nCnt;
  for(; nCnt_1us != 0; nCnt_1us--)
    for(nCnt = 7; nCnt != 0; nCnt--);
}
/*=====================================================================================================*/
/*=====================================================================================================*
**函數 : Delay_1ms
**功能 : 延遲 1ms
**輸入 : nCnt_1ms
**輸出 : None
**使用 : Delay_1ms(Times);
**=====================================================================================================*/
/*=====================================================================================================*/
void Delay_1ms( vu32 nCnt_1ms )
{
  u32 nCnt;
  for(; nCnt_1ms != 0; nCnt_1ms--)
    for(nCnt = 10285; nCnt != 0; nCnt--);
}
/*=====================================================================================================*/
/*=====================================================================================================*
**函數 : Delay_10ms
**功能 : 延遲 10ms
**輸入 : nCnt_10ms
**輸出 : None
**使用 : Delay_10ms(Times);
**=====================================================================================================*/
/*=====================================================================================================*/
void Delay_10ms( vu32 nCnt_10ms )
{
  u32 nCnt;
  for(; nCnt_10ms != 0; nCnt_10ms--)
    for(nCnt = 102855; nCnt != 0; nCnt--);
}
/*=====================================================================================================*/
/*=====================================================================================================*
**函數 : Delay_20ms
**功能 : 延遲 20ms
**輸入 : nCnt_20ms
**輸出 : None
**使用 : Delay_20ms(Times);
**=====================================================================================================*/
/*=====================================================================================================*/
void Delay_20ms(vu32 nCnt_20ms)
{	
  vu32 nCnt;
  for(; nCnt_20ms != 0; nCnt_20ms--)
    for(nCnt = 205710; nCnt != 0; nCnt--);
}
/*=====================================================================================================*/
/*=====================================================================================================*/

