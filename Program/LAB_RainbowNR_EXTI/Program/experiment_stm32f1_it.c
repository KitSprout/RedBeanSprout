/*=====================================================================================================*/
/*=====================================================================================================*/
#include "stm32f1_system.h"
/*=====================================================================================================*/
/*=====================================================================================================*/
#define LED_B   PCO(13)
#define LED_G   PCO(14)
#define LED_R   PCO(15)
/*=====================================================================================================*/
/*=====================================================================================================*/
void EXTI0_IRQHandler( void )
{
  if(EXTI_GetITStatus(EXTI_Line0) != RESET) {
    LED_B = 0;
    Delay_10ms(10);
    LED_B = 1;
    Delay_10ms(10);
    EXTI_ClearITPendingBit(EXTI_Line0);
  }
}
/*=====================================================================================================*/
/*=====================================================================================================*/
void SysTick_Handler( void )
{
}
/*=====================================================================================================*/
/*=====================================================================================================*/
void HardFault_Handler( void )
{
  while(1);
}
void MemManage_Handler( void )
{
  while(1);
}
void BusFault_Handler( void )
{
  while(1);
}
void UsageFault_Handler( void )
{
  while(1);
}
void SVC_Handler( void )
{
  while(1);
}
void DebugMon_Handler( void )
{
  while(1);
}
void PendSV_Handler( void )
{
  while(1);
}
void NMI_Handler( void )
{
  while(1);
}
/*=====================================================================================================*/
/*=====================================================================================================*/

