/*====================================================================================================*/
/*====================================================================================================*/
#include "stm32f1_system.h"
#include "stm32f1_usart.h"
/*====================================================================================================*/
/*====================================================================================================*
**函數 : UART_SendByte
**功能 : Send Byte
**輸入 : huart, *sendData
**輸出 : None
**使用 : UART_SendByte(&huart, 'A');
**====================================================================================================*/
/*====================================================================================================*/
void UART_SendByte( UART_HandleTypeDef *huart, uint8_t *sendData )
{
  huart->Instance->DR = (*sendData & (uint16_t)0x01FF);
  while(!__HAL_UART_GET_FLAG(huart, UART_FLAG_TXE));
}
/*====================================================================================================*/
/*====================================================================================================*
**函數 : UART_RecvByte
**功能 : Recv Byte
**輸入 : huart, *recvByte
**輸出 : None
**使用 : UART_RecvByte(&huart, recvData);
**====================================================================================================*/
/*====================================================================================================*/
void UART_RecvByte( UART_HandleTypeDef *huart, uint8_t *recvData )
{
  while(!__HAL_UART_GET_FLAG(huart, UART_FLAG_RXNE));
  *recvData = (uint16_t)(huart->Instance->DR & (uint16_t)0x01FF);
}
/*====================================================================================================*/
/*====================================================================================================*
**函數 : UART_RecvByteWTO
**功能 : Recv Byte with Timeout
**輸入 : huart, *recvData, timeout
**輸出 : State
**使用 : UART_RecvByteWTO(huart, recvData, 200);
**====================================================================================================*/
/*====================================================================================================*/
int8_t UART_RecvByteWTO( UART_HandleTypeDef *huart, uint8_t *recvData, uint32_t timeout )
{
  while(!__HAL_UART_GET_FLAG(huart, UART_FLAG_RXNE)) {
    if(timeout-- > 0)
      HAL_Delay(1);
    else
      return ERROR; // timeout
  }
  *recvData = (uint16_t)(huart->Instance->DR & (uint16_t)0x01FF);

  return SUCCESS;
}
/*====================================================================================================*/
/*====================================================================================================*
**函數 : UART_SendData
**功能 : Send Bytes
**輸入 : USARTx, *SendData, DataLen
**輸出 : None
**使用 : UART_SendByte(USART1, SendData, DataLen);
**====================================================================================================*/
/*====================================================================================================*/
void UART_SendData( UART_HandleTypeDef *huart, uint8_t *sendData, uint16_t dataLen )
{
  do {
    UART_SendByte(huart, sendData++);
  } while(--dataLen);
}
/*====================================================================================================*/
/*====================================================================================================*
**函數 : UART_RecvData
**功能 : Recv Bytes
**輸入 : USARTx, *RecvData, DataLen
**輸出 : None
**使用 : UART_RecvData(USART1, RecvData, DataLen);
**====================================================================================================*/
/*====================================================================================================*/
void UART_RecvData( UART_HandleTypeDef *huart, uint8_t *recvData, uint16_t dataLen )
{
  do {
    UART_RecvByte(huart, recvData++);
  } while(--dataLen);
}
/*====================================================================================================*/
/*====================================================================================================*
**函數 : UART_RecvDataWTO
**功能 : Recv Bytes with Timeout
**輸入 : USARTx, *RecvByte, DataLen, TimeoutMs
**輸出 : State
**使用 : UART_RecvDataWTO(USART1, RecvData, DataLen, 200);
**====================================================================================================*/
/*====================================================================================================*/
int8_t UART_RecvDataWTO( UART_HandleTypeDef *huart, uint8_t *recvData, uint16_t dataLen, uint32_t timeout )
{
  int8_t state = ERROR;

  do {
    state = UART_RecvByteWTO(huart, recvData++, timeout);
    if(state == ERROR)
      return ERROR;
  } while(--dataLen);

  return state;
}
/*====================================================================================================*/
/*====================================================================================================*/
