/*====================================================================================================*/
/*====================================================================================================*/
#include "drivers\stm32f1_system.h"

#include "beanSproutR.h"
/*====================================================================================================*/
/*====================================================================================================*/
void BSR_Init( void )
{
  SystemInit();
  HAL_InitTick();

  BSR_GPIO_Config();
}
/*====================================================================================================*/
/*====================================================================================================*/
void BSR_Loop( void )
{
  while(1) {
    LED_R_Toggle();
    delay_ms(100);
    LED_G_Toggle();
    delay_ms(100);
    LED_B_Toggle();
    delay_ms(100);
    while(KEY_WU_Read()) {
      LED_R_Toggle();
      LED_G_Toggle();
      LED_B_Toggle();
      delay_ms(200);
    }
    while(KEY_BO_Read()) {
      LED_R_Toggle();
      LED_G_Toggle();
      LED_B_Toggle();
      delay_ms(50);
    }
  }
}
/*====================================================================================================*/
/*====================================================================================================*/
